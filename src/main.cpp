#include <Arduino.h>
#include <Wire.h>
#include <Adafruit_MPU6050.h>
#include <Adafruit_NeoPixel.h>
#include <Adafruit_Sensor.h>
#include <driver/i2s.h>

constexpr int kI2cSdaPin = 21;
constexpr int kI2cSclPin = 22;

constexpr i2s_port_t kI2sPort = I2S_NUM_0;
constexpr int kI2sBclkPin = 25;
constexpr int kI2sWsPin = 26;
constexpr int kI2sDataPin = 27;

constexpr int kNeoPixelPin = 5;
constexpr uint16_t kNeoPixelCount = 16;
constexpr uint8_t kNeoPixelBrightness = 36;

constexpr uint32_t kSerialBaud = 115200;
constexpr uint32_t kSampleRate = 22050;
constexpr size_t kFramesPerBuffer = 128;

constexpr float SAMPLE_GAIN = 0.30f;
constexpr float kAccelSmoothingAlpha = 0.08f;
constexpr float kMotionSmoothingAlpha = 0.15f;
constexpr float kPitchSmoothingAlpha = 0.06f;
constexpr float kIntervalSmoothingAlpha = 0.08f;
constexpr float kFlashDecayPerMs = 0.0065f;
constexpr float kQuietThreshold = 0.03f;
constexpr float kStrongMotionThreshold = 0.18f;
constexpr float kMotionNormalizeG = 0.35f;

constexpr uint32_t kImuReadIntervalMs = 20;
constexpr uint32_t kSerialIntervalMs = 200;
constexpr uint32_t kMpuRetryIntervalMs = 1000;
constexpr uint32_t kQuietMinIntervalMs = 700;
constexpr uint32_t kQuietMaxIntervalMs = 1400;
constexpr uint32_t kMotionMinIntervalMs = 0;
constexpr uint32_t kMotionMaxIntervalMs = 500;

constexpr int kSampleArrayApproxLine = __LINE__ + 6;

// ===== SAMPLE ARRAY START =====
// PEGAR AQUÍ EL SAMPLE
//
const int16_t kEmbeddedSample[] = {
    -56, -64, -77, -82, -54, -69, -65, -72, /* 0-7 */
-71, -71, -67, -67, -49, -77, -79, -67, /* 8-15 */
-74, -64, -68, -80, -85, -72, -64, -78, /* 16-23 */
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-192, -44,  66, -87, -205, -163,
};
// ===== SAMPLE ARRAY END =====

constexpr size_t kEmbeddedSampleLength = sizeof(kEmbeddedSample) / sizeof(kEmbeddedSample[0]);

struct SampleVoice {
  bool active;
  float position;
  float pitch;
};

Adafruit_MPU6050 mpu;
Adafruit_NeoPixel strip(kNeoPixelCount, kNeoPixelPin, NEO_GRB + NEO_KHZ800);

bool gMpuConnected = false;
uint8_t gMpuAddress = 0;
bool gUseRawMpu = false;
uint32_t gLastMpuRetryMs = 0;

float gAccelXG = 0.0f;
float gAccelYG = 0.0f;
float gAccelZG = 1.0f;
float gSmoothedAccelXG = 0.0f;
float gAccelMag = 1.0f;
float gLastAccelMag = 1.0f;
float gDeltaAccel = 0.0f;
float gMotionRaw = 0.0f;
float gMotionNorm = 0.0f;
float gMotionIntensity = 0.0f;
float gTargetPitch = 1.0f;
float gSmoothedPitch = 1.0f;
float gChirpIntervalMs = 1000.0f;
float gFlashLevel = 0.0f;
uint32_t gNextChirpMs = 0;
uint32_t gLastLedUpdateMs = 0;
bool gLastChirpTriggered = false;
bool gQuietState = true;

SampleVoice gVoices[2] = {};

int16_t gAudioBuffer[kFramesPerBuffer * 2];

float clampFloat(float value, float minValue, float maxValue) {
  if (value < minValue) return minValue;
  if (value > maxValue) return maxValue;
  return value;
}

int16_t clampToInt16(float value) {
  if (value > 32767.0f) return 32767;
  if (value < -32768.0f) return -32768;
  return static_cast<int16_t>(value);
}

float randomFloat(float minValue, float maxValue) {
  return minValue + (maxValue - minValue) * (static_cast<float>(random(0, 10001)) / 10000.0f);
}

float mapMotionToPitch(float motion) {
  if (motion < kQuietThreshold) {
    return randomFloat(0.95f, 1.08f);
  }

  const float motionCurve = gMotionNorm * gMotionNorm;
  const float basePitch = 1.00f + motionCurve * 0.04f;
  const float microVariation = randomFloat(-0.01f, 0.01f);
  return clampFloat(basePitch + microVariation, 0.99f, 1.05f);
}

float mapMotionToIntervalMs(float motion) {
  if (motion < kQuietThreshold) {
    return static_cast<float>(random(kQuietMinIntervalMs, kQuietMaxIntervalMs + 1));
  }

  const float motionCurve = gMotionNorm * gMotionNorm;
  return static_cast<float>(kMotionMaxIntervalMs) -
         motionCurve * static_cast<float>(kMotionMaxIntervalMs - kMotionMinIntervalMs);
}

bool i2cAddressResponds(uint8_t address) {
  Wire.beginTransmission(address);
  return Wire.endTransmission() == 0;
}

bool readI2cBytes(uint8_t address, uint8_t reg, uint8_t* buffer, size_t len) {
  Wire.beginTransmission(address);
  Wire.write(reg);
  if (Wire.endTransmission(false) != 0) return false;

  const uint8_t readCount = Wire.requestFrom(address, static_cast<uint8_t>(len));
  if (readCount != len) return false;

  for (size_t i = 0; i < len; ++i) {
    buffer[i] = Wire.read();
  }
  return true;
}

bool readI2cRegister(uint8_t address, uint8_t reg, uint8_t& value) {
  return readI2cBytes(address, reg, &value, 1);
}

bool writeI2cRegister(uint8_t address, uint8_t reg, uint8_t value) {
  Wire.beginTransmission(address);
  Wire.write(reg);
  Wire.write(value);
  return Wire.endTransmission() == 0;
}

void scanI2cBus() {
  Serial.print("I2C scan SDA=");
  Serial.print(kI2cSdaPin);
  Serial.print(" SCL=");
  Serial.print(kI2cSclPin);
  Serial.print(" found:");

  bool foundAny = false;
  for (uint8_t address = 1; address < 127; ++address) {
    if (i2cAddressResponds(address)) {
      Serial.print(" 0x");
      if (address < 16) Serial.print("0");
      Serial.print(address, HEX);
      foundAny = true;
    }
  }

  if (!foundAny) Serial.print(" none");
  Serial.println();
}

void setupI2s() {
  const i2s_config_t i2sConfig = {
      .mode = static_cast<i2s_mode_t>(I2S_MODE_MASTER | I2S_MODE_TX),
      .sample_rate = kSampleRate,
      .bits_per_sample = I2S_BITS_PER_SAMPLE_16BIT,
      .channel_format = I2S_CHANNEL_FMT_RIGHT_LEFT,
      .communication_format = I2S_COMM_FORMAT_STAND_I2S,
      .intr_alloc_flags = ESP_INTR_FLAG_LEVEL1,
      .dma_buf_count = 6,
      .dma_buf_len = kFramesPerBuffer,
      .use_apll = false,
      .tx_desc_auto_clear = true,
      .fixed_mclk = 0,
      .mclk_multiple = I2S_MCLK_MULTIPLE_DEFAULT,
      .bits_per_chan = I2S_BITS_PER_CHAN_DEFAULT,
  };

  const i2s_pin_config_t pinConfig = {
      .mck_io_num = I2S_PIN_NO_CHANGE,
      .bck_io_num = kI2sBclkPin,
      .ws_io_num = kI2sWsPin,
      .data_out_num = kI2sDataPin,
      .data_in_num = I2S_PIN_NO_CHANGE,
  };

  ESP_ERROR_CHECK(i2s_driver_install(kI2sPort, &i2sConfig, 0, nullptr));
  ESP_ERROR_CHECK(i2s_set_pin(kI2sPort, &pinConfig));
  ESP_ERROR_CHECK(i2s_zero_dma_buffer(kI2sPort));
}

void setupNeoPixel() {
  strip.begin();
  strip.setBrightness(kNeoPixelBrightness);
  strip.clear();
  strip.show();
}

bool initMpu() {
  gMpuConnected = false;
  gMpuAddress = 0;
  gUseRawMpu = false;

  if (mpu.begin(0x68, &Wire)) {
    gMpuConnected = true;
    gMpuAddress = 0x68;
  } else if (mpu.begin(0x69, &Wire)) {
    gMpuConnected = true;
    gMpuAddress = 0x69;
  }

  if (gMpuConnected) {
    mpu.setAccelerometerRange(MPU6050_RANGE_2_G);
    mpu.setGyroRange(MPU6050_RANGE_250_DEG);
    mpu.setFilterBandwidth(MPU6050_BAND_21_HZ);
    Serial.print("MPU6050 conectado por Adafruit en 0x");
    Serial.println(gMpuAddress, HEX);
    return true;
  }

  const uint8_t candidates[] = {0x68, 0x69};
  for (uint8_t address : candidates) {
    if (!i2cAddressResponds(address)) continue;

    uint8_t whoAmI = 0;
    readI2cRegister(address, 0x75, whoAmI);
    Serial.print("MPU-like en 0x");
    Serial.print(address, HEX);
    Serial.print(" WHO_AM_I=0x");
    if (whoAmI < 16) Serial.print("0");
    Serial.println(whoAmI, HEX);

    if (!writeI2cRegister(address, 0x6B, 0x00)) continue;
    writeI2cRegister(address, 0x1C, 0x00);  // accel +/-2g
    writeI2cRegister(address, 0x1A, 0x04);  // low-pass filter near 21 Hz

    gMpuConnected = true;
    gMpuAddress = address;
    gUseRawMpu = true;
    Serial.println("Usando lectura raw compatible MPU por registros.");
    return true;
  }

  Serial.println("ERROR: MPU no inicializo en 0x68 ni 0x69. Sample usa velocidad fija.");
  return false;
}

void setupMpu() {
  Wire.begin(kI2cSdaPin, kI2cSclPin);
  Wire.setClock(100000);
  scanI2cBus();
  initMpu();
}

void updateMotionMetrics() {
  gAccelMag = sqrtf(gAccelXG * gAccelXG + gAccelYG * gAccelYG + gAccelZG * gAccelZG);
  gDeltaAccel = fabsf(gAccelMag - gLastAccelMag);
  gLastAccelMag = gAccelMag;

  const float motionAccel = fabsf(gAccelMag - 1.0f);
  gMotionRaw = motionAccel * 0.6f + gDeltaAccel * 2.5f;
  gMotionIntensity = gMotionIntensity * (1.0f - kMotionSmoothingAlpha) +
                     gMotionRaw * kMotionSmoothingAlpha;
  gMotionNorm = clampFloat(gMotionIntensity / kMotionNormalizeG, 0.0f, 1.0f);
}

void updateImu() {
  if (!gMpuConnected) {
    gAccelXG = 0.0f;
    gAccelYG = 0.0f;
    gAccelZG = 1.0f;
    gSmoothedAccelXG += (gAccelXG - gSmoothedAccelXG) * kAccelSmoothingAlpha;
    gMotionRaw = 0.0f;
    gDeltaAccel = 0.0f;
    gAccelMag = 1.0f;
    gMotionIntensity = gMotionIntensity * (1.0f - kMotionSmoothingAlpha);
    gMotionNorm = clampFloat(gMotionIntensity / kMotionNormalizeG, 0.0f, 1.0f);
    return;
  }

  if (gUseRawMpu) {
    uint8_t raw[6] = {};
    if (!readI2cBytes(gMpuAddress, 0x3B, raw, sizeof(raw))) {
      gMpuConnected = false;
      gMpuAddress = 0;
      gUseRawMpu = false;
      Serial.println("ERROR: lectura raw MPU fallo. Sample usa velocidad fija.");
      return;
    }

    const int16_t accelXRaw = static_cast<int16_t>((raw[0] << 8) | raw[1]);
    const int16_t accelYRaw = static_cast<int16_t>((raw[2] << 8) | raw[3]);
    const int16_t accelZRaw = static_cast<int16_t>((raw[4] << 8) | raw[5]);
    gAccelXG = static_cast<float>(accelXRaw) / 16384.0f;
    gAccelYG = static_cast<float>(accelYRaw) / 16384.0f;
    gAccelZG = static_cast<float>(accelZRaw) / 16384.0f;
  } else {
    sensors_event_t accel;
    sensors_event_t gyro;
    sensors_event_t temp;
    if (!mpu.getEvent(&accel, &gyro, &temp)) {
      gMpuConnected = false;
      gMpuAddress = 0;
      gUseRawMpu = false;
      Serial.println("ERROR: lectura MPU6050 fallo. Sample usa velocidad fija.");
      return;
    }

    gAccelXG = accel.acceleration.x / SENSORS_GRAVITY_STANDARD;
    gAccelYG = accel.acceleration.y / SENSORS_GRAVITY_STANDARD;
    gAccelZG = accel.acceleration.z / SENSORS_GRAVITY_STANDARD;
  }

  gSmoothedAccelXG += (gAccelXG - gSmoothedAccelXG) * kAccelSmoothingAlpha;
  updateMotionMetrics();
}

float readSampleInterpolated(float position) {
  const size_t indexA = static_cast<size_t>(position);
  const size_t indexB = min(indexA + 1, kEmbeddedSampleLength - 1);
  const float fraction = position - static_cast<float>(indexA);
  const float a = static_cast<float>(kEmbeddedSample[indexA]);
  const float b = static_cast<float>(kEmbeddedSample[indexB]);
  return a + (b - a) * fraction;
}

void triggerChirp(uint32_t now) {
  SampleVoice* voice = nullptr;
  for (SampleVoice& candidate : gVoices) {
    if (!candidate.active) {
      voice = &candidate;
      break;
    }
  }

  if (voice == nullptr) {
    voice = &gVoices[0];
  }

  gQuietState = gMotionIntensity < kQuietThreshold;
  gTargetPitch = mapMotionToPitch(gMotionIntensity);
  gSmoothedPitch += (gTargetPitch - gSmoothedPitch) * kPitchSmoothingAlpha;

  voice->active = true;
  voice->position = 0.0f;
  voice->pitch = gSmoothedPitch;

  gFlashLevel = 1.0f;
  gLastChirpTriggered = true;

  const float targetInterval = mapMotionToIntervalMs(gMotionIntensity);
  gChirpIntervalMs += (targetInterval - gChirpIntervalMs) * kIntervalSmoothingAlpha;
  gNextChirpMs = now + static_cast<uint32_t>(gChirpIntervalMs);
}

void updateChirpScheduler(uint32_t now) {
  gQuietState = gMotionIntensity < kQuietThreshold;
  gSmoothedPitch += (mapMotionToPitch(gMotionIntensity) - gSmoothedPitch) * kPitchSmoothingAlpha;

  if (gNextChirpMs == 0 || now >= gNextChirpMs) {
    triggerChirp(now);
  }
}

void updateNeoPixel(uint32_t now) {
  const uint32_t elapsedMs = now - gLastLedUpdateMs;
  gLastLedUpdateMs = now;

  if (elapsedMs > 0 && gFlashLevel > 0.0f) {
    gFlashLevel = clampFloat(gFlashLevel - static_cast<float>(elapsedMs) * kFlashDecayPerMs, 0.0f, 1.0f);
  }

  const uint8_t red = static_cast<uint8_t>(255.0f * gFlashLevel);
  const uint8_t green = static_cast<uint8_t>(120.0f * gFlashLevel);
  const uint8_t blue = static_cast<uint8_t>(20.0f * gFlashLevel);
  const uint32_t color = strip.Color(red, green, blue);

  for (uint16_t i = 0; i < kNeoPixelCount; ++i) {
    strip.setPixelColor(i, color);
  }
  strip.show();
}

void writeAudioBuffer() {
  for (size_t i = 0; i < kFramesPerBuffer; ++i) {
    float mixedSample = 0.0f;
    for (SampleVoice& voice : gVoices) {
      if (!voice.active) {
        continue;
      }

      mixedSample += readSampleInterpolated(voice.position);
      voice.position += voice.pitch;
      if (voice.position >= static_cast<float>(kEmbeddedSampleLength - 1)) {
        voice.active = false;
      }
    }

    const int16_t pcm = clampToInt16(mixedSample * SAMPLE_GAIN);

    gAudioBuffer[i * 2] = pcm;
    gAudioBuffer[i * 2 + 1] = pcm;
  }

  size_t bytesWritten = 0;
  i2s_write(kI2sPort, gAudioBuffer, sizeof(gAudioBuffer), &bytesWritten, portMAX_DELAY);
}

void printStatus() {
  Serial.print("mpu=");
  Serial.print(gMpuConnected ? "OK" : "ERROR");
  if (gMpuConnected) {
    Serial.print(" addr=0x");
    Serial.print(gMpuAddress, HEX);
    Serial.print(gUseRawMpu ? " mode=raw" : " mode=adafruit");
  }
  Serial.print(" ax_g=");
  Serial.print(gSmoothedAccelXG, 3);
  Serial.print(" accelMag=");
  Serial.print(gAccelMag, 3);
  Serial.print(" deltaAccel=");
  Serial.print(gDeltaAccel, 3);
  Serial.print(" motionRaw=");
  Serial.print(gMotionRaw, 3);
  Serial.print(" motionSmooth=");
  Serial.print(gMotionIntensity, 3);
  Serial.print(" motionNorm=");
  Serial.print(gMotionNorm, 3);
  Serial.print(" motion=");
  Serial.print(gMotionIntensity, 3);
  Serial.print(" state=");
  Serial.print(gQuietState ? "quiet" : "motion");
  Serial.print(" chirpIntervalMs=");
  Serial.print(gChirpIntervalMs, 0);
  Serial.print(" pitch=");
  Serial.print(gSmoothedPitch, 3);
  Serial.print(" chirp=");
  Serial.print(gLastChirpTriggered ? "yes" : "no");
  Serial.print(" flash=");
  Serial.println(gFlashLevel, 2);
  gLastChirpTriggered = false;
}

void setup() {
  Serial.begin(kSerialBaud);
  randomSeed(static_cast<uint32_t>(esp_random()));
  Serial.println();
  Serial.println("Pendular: cricket-style sample chirps -> I2S MAX98357A + NeoPixel");
  Serial.print("Sample array aproximado en src/main.cpp linea ");
  Serial.println(kSampleArrayApproxLine);
  Serial.println("Buscar: ===== SAMPLE ARRAY START ===== / PEGAR AQUÍ EL SAMPLE REAL");

  setupI2s();
  setupNeoPixel();
  setupMpu();

  const uint32_t now = millis();
  gLastLedUpdateMs = now;
  gNextChirpMs = now + 250;
}

void loop() {
  static uint32_t lastImuReadMs = 0;
  static uint32_t lastSerialMs = 0;

  const uint32_t now = millis();

  if (now - lastImuReadMs >= kImuReadIntervalMs) {
    updateImu();
    lastImuReadMs = now;
  }

  if (!gMpuConnected && now - gLastMpuRetryMs >= kMpuRetryIntervalMs) {
    scanI2cBus();
    initMpu();
    gLastMpuRetryMs = now;
  }

  if (now - lastSerialMs >= kSerialIntervalMs) {
    printStatus();
    lastSerialMs = now;
  }

  updateChirpScheduler(now);
  updateNeoPixel(now);
  writeAudioBuffer();
}
